## config/boards/shields/lazy_pinky_18/Kconfig.defconfig
```kconfig
# Copyright (c) 2020 The ZMK Contributors
# SPDX-License-Identifier: MIT

config ZMK_BLE
	default y

config ZMK_USB
	default y

config ZMK_KEYBOARD_NAME
	default "LazyPinky18"

config ZMK_SPLIT
	default y

if SHIELD_LAZY_PINKY_18_LEFT 

config ZMK_SPLIT_BLE_ROLE_CENTRAL
	default y

endif

if ZMK_BACKLIGHT

config PWM
    default y

config LED_PWM
    default y

endif # ZMK_BACKLIGHT
```

## config/boards/shields/lazy_pinky_18/Kconfig.shield
```kconfig
# Copyright (c) 2020 The ZMK Contributors
# SPDX-License-Identifier: MIT

config SHIELD_LAZY_PINKY_18_LEFT
	def_bool $(shields_list_contains,lazy_pinky_18_left)

config SHIELD_LAZY_PINKY_18_RIGHT
	def_bool $(shields_list_contains,lazy_pinky_18_right)
	
```

## config/west.yml
```yaml
manifest:
  remotes:
    - name: ftc
      url-base: https://github.com/ftc
  projects:
    - name: zmk
      remote: ftc
      revision: mouse-ftc
      import: app/west.yml
  self:
    path: config
```
