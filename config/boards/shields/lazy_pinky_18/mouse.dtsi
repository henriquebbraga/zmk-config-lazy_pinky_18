#include <dt-bindings/zmk/mouse.h>

//&mmv {
  //acceleration-exponent = <1>;      // 1
  //time-to-max-speed-ms = <1500>;    // 40
  //delay-ms = <0>;                   // 0
//};
//
//&mwh {
  //acceleration-exponent = <1>;      // 0
  //time-to-max-speed-ms = <5000>;    // 40
  //delay-ms = <0>;                   // 10
//};

&mmv {
  delay-ms = <0>;
  time-to-max-speed-ms = <500>;
  acceleration-exponent = <1>;
};

&msc {
  delay-ms = <0>;
  time-to-max-speed-ms = <250>;
  acceleration-exponent = <0>;
};

// custom stuff
#define M_MOVE_SPEED 1600
#define MOVE_UP_H MOVE_Y(-M_MOVE_SPEED)
#define MOVE_DOWN_H MOVE_Y(M_MOVE_SPEED)
#define MOVE_LEFT_H MOVE_X(-M_MOVE_SPEED)
#define MOVE_RIGHT_H MOVE_X(M_MOVE_SPEED)

#define M_SCROLL_SPEED 110
#define SCROLL_UP_H SCRL_Y(-M_SCROLL_SPEED)
#define SCROLL_DOWN_H SCRL_Y(M_SCROLL_SPEED)
#define SCROLL_LEFT_H SCRL_X(M_SCROLL_SPEED)
#define SCROLL_RIGHT_H SCRL_X(-M_SCROLL_SPEED)

#define SCROLL_UP_FAST SCRL_Y(-800)
